## arch/arm/mach-s3c6400/Kconfig
```kconfig
# arch/arm/mach-s3c6400/Kconfig
#
# Copyright 2007 Simtec Electronics
#
# Licensed under GPLv2

menu "S3C6400 Machines"

config MACH_SMDK6400
	bool "SMDK6400"
	select CPU_S3C6400
	help
	  Say Y here if you are using the SMDK6400
	  
config S3C6400_PDFW
        tristate "S3C6400 Power Domain Framework"
        depends on CPU_S3C6400
        help
          Install power domain framework for S3C6400

config S3C6400_PDFW_PROC
	bool "/proc filesystem support for pdfw"
	depends on CPU_S3C6400 && S3C6400_PDFW
	help
		proc file system for S3C6400 Power Domain Framework

config S3C6400_KDPMD
	tristate "S3C6400 Kernel Dynamic Power Management Daemon"
	depends on CPU_S3C6400	&& S3C6400_PDFW
	help
	  Install kernel dynamic power management daemon
endmenu

config CPU_S3C6400
	bool
	depends on ARCH_S3C2410
	select S3C6400_PM if PM
	help
	  Support for S3C6400 Samsung Mobile CPU based systems.

config S3C6400_PM
	bool
	help
	  Internal config node to apply S3C6400 power management
```

## arch/arm/mach-s3c6410/Kconfig
```kconfig
# arch/arm/mach-s3c6400/Kconfig
#
# Copyright 2007 Simtec Electronics
#
# Licensed under GPLv2

menu "S3C6410 Machines"

config MACH_SMDK6410
	bool "SMDK6410"
	select CPU_S3C6410
	select MACH_SMDK
	help
	  Say Y here if you are using the SMDK6410
	  
config MACH_SMDK6430
	bool "SMDK6430/6431"
	select CPU_S3C6410
	select MACH_SMDK
	help
	  Say Y here if you are using the SMDK6430

config S3C6410_PDFW
        tristate "S3C6410 Power Domain Framework"
        depends on CPU_S3C6410
        help
          Install power domain framework for S3C6410

config S3C6410_PDFW_PROC
	bool "/proc filesystem support for pdfw"
	depends on CPU_S3C6410 && S3C6410_PDFW
	help
		proc file system for S3C6410 Power Domain Framework

config S3C6410_KDPMD
	tristate "S3C6410 Kernel Dynamic Power Management Daemon"
	depends on CPU_S3C6410	&& S3C6410_PDFW
	help
	  Install kernel dynamic power management daemon
endmenu

config CPU_S3C6410
	bool
	depends on ARCH_S3C2410
	select S3C6410_PM if PM
	help
	  Support for S3C6410 Samsung Mobile CPU based systems.

config S3C6410_PM
	bool
	help
	  Internal config node to apply S3C6410 power management
```

## arch/arm/mach-s3c6410/pwm/Kconfig
```kconfig
#
# PWM Timer configuration
#

menu "Pulse Width Modulation Timer"

config PWM
	tristate "Pulse Width Modulation (PWM) Timer support"

#config S3C2450_PWM
#         bool "S3C2450 PWM support"
#         depends on CPU_S3C2450 && PWM
#         help
#            S3C2450 PWM support.

#config S3C2416_PWM
#         bool "S3C2416 PWM support"
#         depends on CPU_S3C2416 && PWM
#         help
#            S3C2416 PWM support.

config S3C6410_PWM
         bool "S3C6410/30 PWM support"
         depends on CPU_S3C6410 && PWM
         help
           S3C6410 PWM support.
endmenu
```

## arch/arm/mach-s5pc100/Kconfig
```kconfig
# arch/arm/mach-s5pc100/Kconfig
#
# Licensed under GPLv2

menu "S5PC100 Machines"

config MACH_SMDKC100
	bool "SMDKC100"
	select CPU_S5PC100
	select MACH_SMDK
	help
	  Say Y here if you are using the S5PC100
endmenu

config CPU_S5PC100
	bool
	depends on ARCH_S3C2410
	select S5PC100_PM if PM
	help
	  Support for S5PC100 Samsung Mobile CPU based systems.

config S5PC100_PM
	bool
	help
	  Internal config node to apply S5PC100 power management
```

## arch/arm/plat-s3c24xx/Kconfig
```kconfig
# arch/arm/plat-s3c24xx/Kconfig
#
# Copyright 2007 Simtec Electronics
#
# Licensed under GPLv2

config PLAT_S3C24XX
	bool
	depends on ARCH_S3C2410 && (CPU_S3C2443 || CPU_S3C2450 || CPU_S3C2416)
	default y if ARCH_S3C2410
	select NO_IOPORT
	help
	  Base platform code for any Samsung S3C24XX device

if PLAT_S3C24XX
config CPU_S3C244X
	bool
	depends on ARCH_S3C2410 && (CPU_S3C2440 || CPU_S3C2442)
	help
	  Support for S3C2440 and S3C2442 Samsung Mobile CPU based systems.

config PM_SIMTEC
	bool
	help
	  Common power management code for systems that are
	  compatible with the Simtec style of power management

config S3C2410_DMA
	bool "S3C2410 DMA support"
	depends on ARCH_S3C2410
	help
	  S3C2410 DMA support. This is needed for drivers like sound which
	  use the S3C2410's DMA system to move data to and from the
	  peripheral blocks.

config S3C2410_DMA_DEBUG
	bool "S3C2410 DMA support debug"
	depends on ARCH_S3C2410 && S3C2410_DMA
	help
	  Enable debugging output for the DMA code. This option sends info
	  to the kernel log, at priority KERN_DEBUG.

config S3C24XX_ADC
        bool "S3C24XX ADC Driver"
        depends on CPU_S3C2443 || CPU_S3C2450
        help
          ADC (A/D Conversion) driver for Samsung S3C2443/2450.

endif
```

## arch/arm/plat-s3c64xx/Kconfig
```kconfig
# arch/arm/plat-s3c64xx/Kconfig
#
# Copyright 2007 Simtec Electronics
#
# Licensed under GPLv2

config PLAT_S3C64XX
	bool "S3C64XX Platform support"
	depends on ARCH_S3C2410 && (CPU_S3C6400 || CPU_S3C6410)
	default y if CPU_S3C6400
	help
	  Support for S3C6400 and S3C64XX series Samsung Mobile CPU based systems.

if PLAT_S3C64XX
config S3C64XX_DMA
	bool "S3C64XX DMA support"
	depends on CPU_S3C6400 || CPU_S3C6410
	help
	  S3C6400(6410) DMA support. This is needed for drivers like sound which
	  use the S3C6400(6410)'s DMA system to move data to and from the
	  peripheral blocks.

config S3C64XX_ADC
	bool "S3C64XX ADC Driver"
	depends on CPU_S3C6400 || CPU_S3C6410
	help
	  ADC (A/D Conversion) driver for Samsung S3C6400/6410.
endif
```

## arch/arm/plat-s5pc1xx/Kconfig
```kconfig
# arch/arm/plat-s5pc1xx/Kconfig
#
# Licensed under GPLv2

config PLAT_S5PC1XX
	bool "S5PC1XX Platform support"
	depends on ARCH_S3C2410 && CPU_S5PC100
	default y if CPU_S5PC100
	help
	  Support for S5PC100 Samsung Mobile CPU based systems.

if PLAT_S5PC1XX
config S5PC1XX_DMA
	bool "S5PC1XX DMA support"
	depends on CPU_S5PC100
	help
	  S5PC100 DMA support. This is needed for drivers like sound which
	  use the S5PC100's DMA system to move data to and from the
	  peripheral blocks.
endif
```

## drivers/android/Kconfig
```kconfig
menu "Android"

config ANDROID_RAM_CONSOLE
	bool "RAM buffer console"
	default n

config ANDROID_RAM_CONSOLE_ENABLE_VERBOSE
	bool "Enable verbose console messages"
	default y
	depends on ANDROID_RAM_CONSOLE

menuconfig ANDROID_RAM_CONSOLE_ERROR_CORRECTION
	bool "Enable error correction"
	default n
	depends on ANDROID_RAM_CONSOLE
	select REED_SOLOMON
	select REED_SOLOMON_ENC8
	select REED_SOLOMON_DEC8

if ANDROID_RAM_CONSOLE_ERROR_CORRECTION

config ANDROID_RAM_CONSOLE_ERROR_CORRECTION_DATA_SIZE
	int "Data data size"
	default 128
	help
	  Must be a power of 2.

config ANDROID_RAM_CONSOLE_ERROR_CORRECTION_ECC_SIZE
	int "ECC size"
	default 16

config ANDROID_RAM_CONSOLE_ERROR_CORRECTION_SYMBOL_SIZE
	int "Symbol size"
	default 8

config ANDROID_RAM_CONSOLE_ERROR_CORRECTION_POLYNOMIAL
	hex "Polynomial"
	default 0x19 if (ANDROID_RAM_CONSOLE_ERROR_CORRECTION_SYMBOL_SIZE = 4)
	default 0x29 if (ANDROID_RAM_CONSOLE_ERROR_CORRECTION_SYMBOL_SIZE = 5)
	default 0x61 if (ANDROID_RAM_CONSOLE_ERROR_CORRECTION_SYMBOL_SIZE = 6)
	default 0x89 if (ANDROID_RAM_CONSOLE_ERROR_CORRECTION_SYMBOL_SIZE = 7)
	default 0x11d if (ANDROID_RAM_CONSOLE_ERROR_CORRECTION_SYMBOL_SIZE = 8)
	
endif #ANDROID_RAM_CONSOLE_ERROR_CORRECTION

config ANDROID_RAM_CONSOLE_EARLY_INIT
	bool "Start ram console early"
	default n
	depends on ANDROID_RAM_CONSOLE

config ANDROID_RAM_CONSOLE_EARLY_ADDR
	hex "RAM console virtual address"
	default 0
	depends on ANDROID_RAM_CONSOLE_EARLY_INIT

config ANDROID_RAM_CONSOLE_EARLY_SIZE
	hex "RAM console buffer size"
	default 0
	depends on ANDROID_RAM_CONSOLE_EARLY_INIT

config ANDROID_POWER
	bool "Android power driver"
	depends on PM && RTC_CLASS
	default n

config ANDROID_POWER_ALARM
	bool "Android alarm driver"
	depends on ANDROID_POWER
	default y

config ANDROID_POWER_STAT
	bool "Android power driver lock stats"
	depends on ANDROID_POWER
	default y

config ANDROID_LOGGER
	bool "Android log driver"
	default y

config ANDROID_TIMED_GPIO
	bool "Android timed gpio driver"
	depends on GENERIC_GPIO
	default y

config ANDROID_BINDER_IPC
	tristate "Binder IPC Driver"
	default y

config ANDROID_PARANOID_NETWORK
	bool "Only allow certain groups to create sockets"
	default y
	help
		none

endmenu
```

## drivers/char/s3c-dvfs/Kconfig
```kconfig
#
# DVFS (Dynamic voltage/frequency Scaling)
#

menu "DVFS support"

config DVFS
	tristate "Support for DVFS on SMDK64xx Board"
	depends on CPU_S3C6400 || CPU_S3C6410

endmenu
```

## sound/soc/s3c24xx/Kconfig
```kconfig
menu "SoC Audio for the Samsung S3C"
	depends on PLAT_S3C24XX && ARCH_S3C2410 && SND_SOC

config SND_S3C_SOC
	tristate "SoC Audio for the Samsung S3C chips"
	depends on ARCH_S3C2410 && SND_SOC
	select SND_PCM
	help
	  Say Y or M if you want to add support for codecs attached to
	  the S3C AC97, I2S or SSP interface. You will also need
	  to select the audio interfaces to support below.

config SND_S3C_SOC_I2S
	tristate

config SND_S3C2450_SOC_I2S
	tristate
	
config SND_SOC_I2S_V40
	tristate

config SND_S3C2443_SOC_AC97
	tristate
	select AC97_BUS
	select SND_AC97_CODEC
	select SND_SOC_AC97_BUS
	
config SND_S3C2450_SOC_AC97
	tristate
	select AC97_BUS
	select SND_AC97_CODEC
	select SND_SOC_AC97_BUS

config SND_S3C24XX_SOC_SMDK2450_WM9713
	tristate "SoC AC97 Audio support for SMDK2450 - WM9713"
	depends on SND_S3C_SOC && (CPU_S3C2450 || CPU_S3C2416)
	select SND_S3C2450_SOC_AC97
	select SND_SOC_WM9713
	help
	  Say Y if you want to add support for SoC audio on smdk2450
	  with the WM9713.
choice
        prompt "SMDK Record Path Select"
	depends on SND_S3C24XX_SOC_SMDK2450_WM9713

config SOUND_WM9713_INPUT_STREAM_LINE
	bool "Input Stream is LINE-IN"
	depends on SND_S3C24XX_SOC_SMDK2450_WM9713
	help
	  Say Y here to make input stream as LINE-IN.

config SOUND_WM9713_INPUT_STREAM_MIC
	bool "Input Stream is MIC"
	depends on SND_S3C24XX_SOC_SMDK2450_WM9713
	help
	  Say Y here to make input stream as MIC.
endchoice



config SND_S3C24XX_SOC_NEO1973_WM8753
	tristate "SoC I2S Audio support for NEO1973 - WM8753"
	depends on SND_S3C_SOC && MACH_NEO1973_GTA01
	select SND_S3C_SOC_I2S
	select SND_SOC_WM8753
	help
	  Say Y if you want to add support for SoC audio on smdk2440
	  with the WM8753.

config SND_S3C24XX_SOC_SMDK2443_WM9710
	tristate "SoC AC97 Audio support for SMDK2443 - WM9710"
	depends on SND_S3C_SOC && MACH_SMDK2443
	select SND_S3C2443_SOC_AC97
	select SND_SOC_AC97_CODEC
	help
	  Say Y if you want to add support for SoC audio on smdk2443
	  with the WM9710.

config SND_S3C24XX_SOC_SMDK2450_WM8580
	tristate "SoC I2S Audio support for SMDK2450 - WM8580"
	depends on SND_S3C_SOC && (CPU_S3C2450 || CPU_S3C2416)
	select SND_S3C2450_SOC_I2S
	select SND_SOC_WM8580
	select SND_SOC_I2S_V40
	help
	  Say Y if you want to add support for SoC audio on smdk2450
	  with the WM8580.

endmenu
```

## sound/soc/s3c64xx/Kconfig
```kconfig
menu "SoC Audio for the Samsung S3C"
	depends on PLAT_S3C64XX && ARCH_S3C2410 && SND_SOC

config SND_S3C_SOC
	tristate "SoC Audio for the Samsung S3C chips"
	depends on ARCH_S3C2410 && SND_SOC
	select SND_PCM
	help
	  Say Y or M if you want to add support for codecs attached to
	  the S3C AC97, I2S or SSP interface. You will also need
	  to select the audio interfaces to support below.


config SND_S3C_SOC_I2S
	tristate

config SND_S3C6410_SOC_I2S_V32
	tristate

config SND_S3C6410_SOC_I2S
	tristate

config SND_SOC_I2S_V40
	tristate

config SND_S3C64XX_SOC_SMDK6410_WM9713
	tristate "SoC AC97 Audio support for SMDK6410 - WM9713"
	depends on SND_S3C_SOC && (MACH_SMDK6410)
	select SND_S3C6410_SOC_AC97
	select SND_SOC_WM9713
	help
	  Say Y if you want to add support for SoC audio on smdk6410
	  with the WM9713.
	
choice
        prompt "SMDK Record Path Select"
	depends on SND_S3C64XX_SOC_SMDK6400_WM9713 || SND_S3C64XX_SOC_SMDK6410_WM9713

config SOUND_WM9713_INPUT_STREAM_LINE
	bool "Input Stream is LINE-IN"
	depends on SND_S3C64XX_SOC_SMDK6400_WM9713 || SND_S3C64XX_SOC_SMDK6410_WM9713
	help
	  Say Y here to make input stream as LINE-IN.

config SOUND_WM9713_INPUT_STREAM_MIC
	bool "Input Stream is MIC"
	depends on SND_S3C64XX_SOC_SMDK6400_WM9713 || SND_S3C64XX_SOC_SMDK6410_WM9713
	help
	  Say Y here to make input stream as MIC.
endchoice

config SND_S3C6410_SOC_AC97
	tristate
	select AC97_BUS
	select SND_AC97_CODEC
	select SND_SOC_AC97_BUS

config SND_S3C6410_SOC_SMDK6410_WM8580
	tristate "SoC I2S Audio support for SMDK6410 - WM8580"
	depends on SND_S3C_SOC && (MACH_SMDK6410 || MACH_SMDK6430)
	select SND_S3C6410_SOC_I2S
	select SND_SOC_WM8580
	help
	  Say Y if you want to add support for SoC audio on smdk6410
	  with the WM8580.
	
choice
        prompt "SMDK Record Path Select"
	depends on SND_S3C6410_SOC_SMDK6410_WM8580 || SND_S3C24XX_SOC_SMDK2450_WM8580

config SOUND_WM8580_INPUT_STREAM_LINE
	bool "Input Stream is LINE-IN"
	depends on SND_S3C6410_SOC_SMDK6410_WM8580 || SND_S3C24XX_SOC_SMDK2450_WM8580
	help
	  Say Y here to make input stream as LINE-IN.

config SOUND_WM8580_INPUT_STREAM_MIC
	bool "Input Stream is MIC"
	depends on SND_S3C6410_SOC_SMDK6410_WM8580 || SND_S3C24XX_SOC_SMDK2450_WM8580
	help
	  Say Y here to make input stream as MIC.
endchoice

config SND_S3C64XX_SOC_SMDK6410_WM8990
	tristate "SoC I2S Audio support for SMDK6410 - WM8990"
	depends on SND_S3C_SOC && (MACH_SMDK6410)
	select SND_S3C6410_SOC_I2S_V32
	select SND_SOC_WM8990
	help
	  Say Y if you want to add support for SoC audio on smdk6410
	  with the WM8990.

choice
        prompt "SMDK Record Path Select"
	depends on SND_S3C64XX_SOC_SMDK6410_WM8990 || SND_S3C64XX_SOC_SMDK6400_WM8990

config SOUND_WM8990_INPUT_STREAM_LINE_IN
	bool "Input Stream is LINE-IN"
	depends on SND_S3C64XX_SOC_SMDK6410_WM8990 || SND_S3C64XX_SOC_SMDK6400_WM8990
	help
	  Say Y here to make input stream as LINE-IN.

config SOUND_WM8990_INPUT_STREAM_MIC_IN
	bool "Input Stream is MIC"
	depends on SND_S3C64XX_SOC_SMDK6410_WM8990 || SND_S3C64XX_SOC_SMDK6400_WM8990
	help
	  Say Y here to make input stream as MIC.
endchoice

endmenu
```
